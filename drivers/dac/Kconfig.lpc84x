## drivers/dac/Kconfig.lpc84x
```kconfig
# Copyright (c) 2026 Aerlync Labs Inc.
# SPDX-License-Identifier: Apache-2.0

config DAC_LPC84X
	bool "LPC84X DAC driver"
	default y
	depends on DT_HAS_NXP_LPC84X_DAC_ENABLED
	help
	  DAC driver for LPC84x.
```
